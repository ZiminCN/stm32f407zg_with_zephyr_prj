## boards/arm/f407zg_prj/Kconfig.f407zg_prj
```kconfig
# Copyright (c) 2016 Linaro Limited.
# SPDX-License-Identifier: Apache-2.0

config BOARD_F407ZG_PRJ
	bool "STM32F407ZG SoC"
	select SOC_STM32F407XG
```

## boards/arm/st/f407zg_prj_defconfig
```kconfig
# SPDX-License-Identifier: Apache-2.0

CONFIG_SOC_SERIES_STM32F4X=y
CONFIG_SOC_STM32F407XG=y
CONFIG_F407ZG_PRJ=y
# Enable MPU
CONFIG_ARM_MPU=y

# Enable HW stack protection
CONFIG_HW_STACK_PROTECTION=y

# Enable UART
CONFIG_SERIAL=y

# Console
CONFIG_CONSOLE=y
CONFIG_RTT_CONSOLE=y
CONFIG_USE_SEGGER_RTT=y

CONFIG_LOG=y
# CONFIG_LOG_MODE_DEFERRED=y
# Enable Clocks
CONFIG_CLOCK_CONTROL=y

# Enable GPIO
CONFIG_GPIO=y

CONFIG_UART_ASYNC_API=y

# enable pin controller
CONFIG_PINCTRL=y
```
